; // Generated by Nevada317 for ATmega324PA
.device ATmega32

.equ UDR1    = 0xCE
.equ UBRR1H  = 0xCD
.equ UBRR1L  = 0xCC
.equ UCSR1C  = 0xCA
.equ UCSR1B  = 0xC9
.equ UCSR1A  = 0xC8
.equ UDR0    = 0xC6
.equ UBRR0H  = 0xC5
.equ UBRR0L  = 0xC4
.equ UCSR0C  = 0xC2
.equ UCSR0B  = 0xC1
.equ UCSR0A  = 0xC0
.equ TWAMR   = 0xBD
.equ TWCR    = 0xBC
.equ TWDR    = 0xBB
.equ TWAR    = 0xBA
.equ TWSR    = 0xB9
.equ TWBR    = 0xB8
.equ ASSR    = 0xB6
.equ OCR2B   = 0xB4
.equ OCR2A   = 0xB3
.equ TCNT2   = 0xB2
.equ TCCR2B  = 0xB1
.equ TCCR2A  = 0xB0
.equ OCR1BH  = 0x8B
.equ OCR1BL  = 0x8A
.equ OCR1AH  = 0x89
.equ OCR1AL  = 0x88
.equ ICR1H   = 0x87
.equ ICR1L   = 0x86
.equ TCNT1H  = 0x85
.equ TCNT1L  = 0x84
.equ TCCR1C  = 0x82
.equ TCCR1B  = 0x81
.equ TCCR1A  = 0x80
.equ DIDR1   = 0x7F
.equ DIDR0   = 0x7E
.equ ADMUX   = 0x7C
.equ ADCSRB  = 0x7B
.equ ADCSRA  = 0x7A
.equ ADCH    = 0x79
.equ ADCL    = 0x78
.equ PCMSK3  = 0x73
.equ TIMSK2  = 0x70
.equ TIMSK1  = 0x6F
.equ TIMSK0  = 0x6E
.equ PCMSK2  = 0x6D
.equ PCMSK1  = 0x6C
.equ PCMSK0  = 0x6B
.equ EICRA   = 0x69
.equ PCICR   = 0x68
.equ OSCCAL  = 0x66
.equ PRR     = 0x64
.equ CLKPR   = 0x61
.equ WDTCSR  = 0x60
.equ SREG    = 0x3F
.equ SPH     = 0x3E
.equ SPL     = 0x3D
.equ SPMCSR  = 0x37
.equ MCUCR   = 0x35
.equ MCUSR   = 0x34
.equ SMCR    = 0x33
.equ OCDR    = 0x31
.equ ACSR    = 0x30
.equ SPDR    = 0x2E
.equ SPSR    = 0x2D
.equ SPCR    = 0x2C
.equ GPIOR2  = 0x2B
.equ GPIOR1  = 0x2A
.equ OCR0B   = 0x28
.equ OCR0A   = 0x27
.equ TCNT0   = 0x26
.equ TCCR0B  = 0x25
.equ TCCR0A  = 0x24
.equ GTCCR   = 0x23
.equ EEARH   = 0x22
.equ EEARL   = 0x21
.equ EEDR    = 0x20
.equ EECR    = 0x1F
.equ GPIOR0  = 0x1E
.equ EIMSK   = 0x1D
.equ EIFR    = 0x1C
.equ PCIFR   = 0x1B
.equ TIFR2   = 0x17
.equ TIFR1   = 0x16
.equ TIFR0   = 0x15
.equ PORTD   = 0x0B
.equ DDRD    = 0x0A
.equ PIND    = 0x09
.equ PORTC   = 0x08
.equ DDRC    = 0x07
.equ PINC    = 0x06
.equ PORTB   = 0x05
.equ DDRB    = 0x04
.equ PINB    = 0x03
.equ PORTA   = 0x02
.equ DDRA    = 0x01
.equ PINA    = 0x00

.equ addr_RESET         = 0x0000 ; RESET           External Pin, Power-on Reset, Brown-out Reset, Watchdog Reset, and JTAG AVR Reset
.equ addr_INT0          = 0x0002 ; INT0            External Interrupt Request
.equ addr_INT1          = 0x0004 ; INT1            External Interrupt Request
.equ addr_INT2          = 0x0006 ; INT2            External Interrupt Request
.equ addr_PCINT0        = 0x0008 ; PCINT0          Pin Change Interrupt Request
.equ addr_PCINT1        = 0x000A ; PCINT1          Pin Change Interrupt Request
.equ addr_PCINT2        = 0x000C ; PCINT2          Pin Change Interrupt Request
.equ addr_PCINT3        = 0x000E ; PCINT3          Pin Change Interrupt Request
.equ addr_WDT           = 0x0010 ; WDT             Watchdog Time-out Interrupt
.equ addr_TIMER2_COMPA  = 0x0012 ; TIMER2_COMPA    Timer/Counter2 Compare Match A
.equ addr_TIMER2_COMPB  = 0x0014 ; TIMER2_COMPB    Timer/Counter2 Compare Match B
.equ addr_TIMER2_OVF    = 0x0016 ; TIMER2_OVF      Timer/Counter2 Overflow
.equ addr_TIMER1_CAPT   = 0x0018 ; TIMER1_CAPT     Timer/Counter1 Capture Event
.equ addr_TIMER1_COMPA  = 0x001A ; TIMER1_COMPA    Timer/Counter1 Compare Match A
.equ addr_TIMER1_COMPB  = 0x001C ; TIMER1_COMPB    Timer/Counter1 Compare Match B
.equ addr_TIMER1_OVF    = 0x001E ; TIMER1_OVF      Timer/Counter1 Overflow
.equ addr_TIMER0_COMPA  = 0x0020 ; TIMER0_COMPA    Timer/Counter0 Compare Match A
.equ addr_TIMER0_COMPB  = 0x0022 ; TIMER0_COMPB    Timer/Counter0 Compare match B
.equ addr_TIMER0_OVF    = 0x0024 ; TIMER0_OVF      Timer/Counter0 Overflow
.equ addr_SPI_STC       = 0x0026 ; SPI_STC         SPI Serial Transfer Complete
.equ addr_USART0_RX     = 0x0028 ; USART0_RX       USART0 Rx Complete
.equ addr_USART0_UDRE   = 0x002A ; USART0_UDRE     USART0 Data Register Empty
.equ addr_USART0_TX     = 0x002C ; USART0_TX       USART0 Tx Complete
.equ addr_ANALOG_COMP   = 0x002E ; ANALOG_COMP     Analog Comparator
.equ addr_ADC           = 0x0030 ; ADC             ADC Conversion Complete
.equ addr_EE_READY      = 0x0032 ; EE_READY        EEPROM Ready
.equ addr_TWI           = 0x0034 ; TWI             2-wire Serial Interface
.equ addr_SPM_READY     = 0x0036 ; SPM_READY       Store Program Memory Ready
.equ addr_USART1_RX     = 0x0038 ; USART1_RX       USART1 Rx Complete
.equ addr_USART1_UDRE   = 0x003A ; USART1_UDRE     USART1 Data Register Empty
.equ addr_USART1_TX     = 0x003C ; USART1_TX       USART1 Tx Complete
.equ addr_ISR_END       = 0x003E

.equ RAMSTART           = 0x0100
.equ RAMEND             = 0x08FF

.def XL = R26
.def XH = R27
.def YL = R28
.def YH = R29
.def ZL = R30
.def ZH = R31
